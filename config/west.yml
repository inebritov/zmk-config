## config/west.yml
```yaml
manifest:
  remotes:
    - name: zmkfirmware
      url-base: https://github.com/zmkfirmware
    - name: krikun98
      url-base: https://github.com/krikun98
    - name: inebritov
      url-base: https://github.com/inebritov
  projects:
    - name: zmk
      remote: inebritov
      revision: nrf52833
      import: app/west.yml
  self:
    path: config
```
